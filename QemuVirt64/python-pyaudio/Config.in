## QemuVirt64/python-pyaudio/Config.in
```kconfig
config BR2_PACKAGE_PYTHON_PYAUDIO
	bool "python-pyaudio"
	depends on BR2_PACKAGE_PORTAUDIO
	help
	  Bindings for PortAudio v19, the cross-platform audio input/output
	  stream library.

	  http://people.csail.mit.edu/hubert/pyaudio/
```
